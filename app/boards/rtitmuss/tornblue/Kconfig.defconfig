## app/boards/rtitmuss/tornblue/Kconfig.defconfig
```kconfig
if BOARD_TORNBLUE_LEFT

config ZMK_KEYBOARD_NAME
    default "Tornblue Left"

config ZMK_SPLIT_ROLE_CENTRAL
    default y

endif

if BOARD_TORNBLUE_RIGHT

config ZMK_KEYBOARD_NAME
    default "Tornblue Right"

endif

if BOARD_TORNBLUE_LEFT || BOARD_TORNBLUE_RIGHT

config ZMK_SPLIT
    default y

config BT_CTLR
    default BT

if USB

config USB_NRFX
    default y

config USB_DEVICE_STACK
    default y

endif # USB

config ZMK_BATTERY_VOLTAGE_DIVIDER
    default y

config TORNBLUE_LED_BT_PROFILE
    bool "Use LEDs to indicate active Bluetooth profile"
    default n
    help
      When enabled, the 3 onboard GPIO LEDs show the active
      Bluetooth profile (one LED per profile 0-2, all LEDs on
      for profile 3). When disabled (default), LEDs indicate
      the active keyboard layer (NAV, NUM, SYM).

endif
```

## app/boards/rtitmuss/tornblue/board.yml
```yaml
boards:
  - name: tornblue_left
    vendor: rtitmuss
    socs:
      - name: nrf52840
        variants:
          - name: zmk
  - name: tornblue_right
    vendor: rtitmuss
    socs:
      - name: nrf52840
        variants:
          - name: zmk
```
